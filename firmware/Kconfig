## firmware/Kconfig
```kconfig
# SP-1 marisko firmware application Kconfig.
#
# Pulls in the common USB sample options (CONFIG_SAMPLE_USBD_VID/PID/PRODUCT/...)
# consumed by the vendored sample_usbd_init.c device_next bring-up helper, then
# the standard Zephyr Kconfig tree.

source "samples/subsys/usb/common/Kconfig.sample_usbd"

source "Kconfig.zephyr"
```
