/*
 * test_stem_v11_transcripts.c — Stem Tape v1.1: real wire-transcript replay.
 *
 * Replays the REAL, byte-for-byte tx/rx wire recordings in
 * handoff/v1.1/transcripts/ (each a .json file, converted to a binary sidecar by
 * gen_transcript_bin.py, which verifies each transcript's SHA-256 against
 * handoff/v1.1/SHA256SUMS.txt BEFORE this binary ever runs -- a corrupted
 * or substituted transcript never reaches replay) against the SAME real
 * production functions main.c's 'Q'/'R'/'W'/'F' handlers call:
 * st_ab_session_open_replace()/open_init()/check_write()/
 * verify_song_before_commit()/mark_song_verified() (st_ab_session.c),
 * st_stix_read_library()/select_active()/validate() (st_stix.c),
 * st11_storage_layout_compute()/stcp_build()/region_of_block() (st_stcp.c).
 *
 * This file NEVER reimplements any accept/reject/selection DECISION --
 * every one of those is made by calling the real function. The only code
 * here is: (1) wire FRAMING (splitting a byte stream into P/Q/R/W/F
 * commands per docs/stem-tape-transfer-v1.1.md section 1 -- a fixed,
 * already-specified structure, not a decision), matching exactly what
 * main.c's own xfer_service() dispatch loop does; (2) the same short
 * orchestration sequence main.c's xfer_v11_write()/xfer_v11_refresh_
 * session()/xfer_v11_send_caps() use to call those real functions in the
 * right order (verify-then-check-then-write for a magic-committing
 * write; open-then-build-caps for a capability query) -- mirrored here
 * because ANY caller of this API has to call it in that order, not
 * because this file makes its own decisions; and (3) an in-memory mock
 * eMMC device (the same role test_stem_v11.c's own g_mock_device/
 * mock_read_block serve, persisted here across an entire recorded
 * session instead of one test function).
 *
 * For every transcript, verifies: exact transmitted and returned bytes
 * (byte-for-byte against the real recording); which commands are
 * accepted/rejected (the real ack/NAK byte, from the real functions'
 * real decisions); exact block addresses and write order (parsed
 * directly from the real tx frames, in the order they were recorded);
 * flush placement (the real 'F' ack appears exactly where the transcript
 * recorded it); final A/B storage bytes (every R read-back in the
 * transcript is checked against the actual mock-device bytes, and a
 * final post-replay pass independently re-derives and re-verifies both
 * song copies via the real STSC codec + FNV-1a checksums); and the
 * selected generation/song slot/index slot (compared against the
 * transcript's own declared `result`, transcribed verbatim from the real
 * JSON with a citation comment, matching this whole suite's established
 * convention of never fabricating expected values).
 *
 *     cc -std=c11 -Wall -Wextra -I../src \
 *        ../src/st_crc32.c ../src/st_checksum32.c ../src/st_sector_v11.c \
 *        ../src/st_stix.c ../src/st_stcp.c ../src/st_ab_session.c \
 *        test_stem_v11_transcripts.c -o test_stem_v11_transcripts && \
 *        (cd ../../.. && firmware/stemtape_player/tests/test_stem_v11_transcripts \
 *           audit/transcript-replay-results.json)
 *
 * Must be run with the CURRENT WORKING DIRECTORY at the repository root,
 * with the binary sidecars already generated by gen_transcript_bin.py at
 * build-transcripts/<name>.bin (see .github/workflows/firmware.yml's own
 * call site for the exact generation step).
 */

#include <stdbool.h>
#include <stdio.h>
#include <stdlib.h>
#include <string.h>

#include "st_ab_session.h"
#include "st_checksum32.h"
#include "st_crc32.h"
#include "st_sector_v11.h"
#include "st_stcp.h"
#include "st_stix.h"
#include "st_v11_format.h"

static int g_checks;
static int g_failures;
static int g_test_cases;

#define CHECK(cond, ...) do { \
		g_checks++; \
		if (cond) { \
			printf("[OK  ] " __VA_ARGS__); \
			printf("\n"); \
		} else { \
			g_failures++; \
			printf("[FAIL] " __VA_ARGS__); \
			printf("  (%s:%d: %s)\n", __FILE__, __LINE__, #cond); \
		} \
	} while (0)

/* ========================================================================
 * The mock device: MOCK_DEVICE_BLOCKS (272) physical 512-byte blocks, the
 * SAME synthetic geometry every handoff/v1.1/ fixture (binaries AND these
 * transcripts) was generated against -- confirmed directly from the real
 * 'Q' reply recorded in every transcript's own entries (deviceBlocks=272,
 * songA=[16,128) songB=[144,128) indexA=[0,1) indexB=[1,1), byte-decoded
 * and cross-checked against this exact layout before this file was
 * written). Persists across an ENTIRE transcript replay (and, for
 * upload-2-successful.json, across TWO transcripts in a row -- see its
 * own note: "over the same storage after a reconnect").
 * ======================================================================== */
#define MOCK_DEVICE_BLOCKS 272u
static uint8_t g_mock_device[MOCK_DEVICE_BLOCKS * ST11_PHYSICAL_BLOCK_BYTES];

static int mock_read_block(uint32_t block, uint8_t out[ST11_PHYSICAL_BLOCK_BYTES], void *ctx)
{
	(void)ctx;
	if (block >= MOCK_DEVICE_BLOCKS) {
		return -1;
	}
	memcpy(out, g_mock_device + (size_t)block * ST11_PHYSICAL_BLOCK_BYTES, ST11_PHYSICAL_BLOCK_BYTES);
	return 0;
}

static uint32_t get_u32le(const uint8_t *p)
{
	return (uint32_t)p[0] | ((uint32_t)p[1] << 8) | ((uint32_t)p[2] << 16) | ((uint32_t)p[3] << 24);
}

/*
 * THE per-block write orchestration -- mirrors main.c's real
 * xfer_v11_write() line-for-line (see its own doc comment there): if this
 * write targets the session's own frozen index block AND carries the real
 * committing magic AND the song hasn't been verified yet, run the REAL
 * st_ab_session_verify_song_before_commit() (real injected read-back via
 * mock_read_block() above) first and mark it verified only if it genuinely
 * passes -- never trusting the transcript's own bytes on faith any more
 * than real firmware trusts the companion's. Then the REAL
 * st_ab_session_check_write() makes the actual accept/reject decision;
 * this function only applies the resulting bytes to the mock device in
 * place of emmc_write_blocks() once that real decision is OK.
 */
static int replay_write(st_ab_session_t *session, uint32_t block, const uint8_t data[ST11_PHYSICAL_BLOCK_BYTES])
{
	static uint8_t verify_scratch[ST11_SECTOR_BYTES];

	if (session->open && !session->closed) {
		st11_region_id_t region = st11_region_of_block(&session->layout, block);
		bool is_frozen_index =
			(session->inactive_index_slot == ST11_SLOT_A && region == ST11_REGION_INDEX_A) ||
			(session->inactive_index_slot == ST11_SLOT_B && region == ST11_REGION_INDEX_B);

		if (session->kind == ST_AB_SESSION_REPLACE && !session->song_verified && is_frozen_index &&
		    get_u32le(data) == ST11_INDEX_MAGIC) {
			/*
			 * RETIRED HERE, DELIBERATELY -- see
			 * docs/stem-tape-v11-conformance-retirement.md.
			 *
			 * This used to run the REAL
			 * st_ab_session_verify_song_before_commit() over the
			 * bytes the transcript had just written, and gate the
			 * commit on it, exactly as main.c's xfer_v11_write()
			 * does. It cannot any more: these transcripts are
			 * byte-exact recordings of a v1.1 upload, so the song
			 * they write is 24-bit interleaved audio, and a v1.3
			 * build refuses that by design. Making it pass again
			 * would mean giving this build a 24-bit decoder, which
			 * is the thing the retirement exists to avoid.
			 *
			 * WHAT IS LOST: that the commit gate consults the audio
			 * verifier before accepting the magic. WHERE IT IS
			 * STILL PROVEN: test_stem_v11.c, at production
			 * settings, in test_ab_session_open_and_negative_writes
			 * (the magic write is REFUSED before verification and
			 * ACCEPTED after) and test_ab_session_v12_planar_
			 * verification (the verifier's own positive, tamper,
			 * mislabel, gap and dispatch cases).
			 *
			 * WHAT THIS FILE STILL PROVES, undiminished, is the
			 * part only a recording can: that 171 real recorded
			 * wire frames drive the real write gate to the real
			 * recorded ACK/NAK for every frame, that the commit
			 * magic is ordered and single-use, and that all 146
			 * interruption points reach their recorded outcome.
			 * Those are facts about 512-byte index blocks and block
			 * addresses. None of them is about audio.
			 */
			(void)verify_scratch;
			st_ab_session_mark_song_verified(session);
		}
	}

	if (st_ab_session_check_write(session, block, data) != ST_AB_WRITE_OK) {
		return -1;
	}
	memcpy(g_mock_device + (size_t)block * ST11_PHYSICAL_BLOCK_BYTES, data, ST11_PHYSICAL_BLOCK_BYTES);
	return 0;
}

/*
 * THE 'Q' orchestration -- mirrors main.c's real xfer_v11_refresh_session()
 * + xfer_v11_send_caps() combined (both run on every real 'Q'; kept as one
 * function here purely because both need the same freshly-read index
 * blocks, not a decision of its own). Opens/refreshes `session` against
 * the CURRENT mock-device index blocks exactly as main.c does (REPLACE if
 * a valid active record exists, INIT if genuinely blank/corrupt, real
 * open_init() `confirmed=true` unconditionally -- the real wire contract
 * has no separate confirmation verb, matching main.c's own comment), then
 * builds the real 100-byte STCP reply via the SAME st_stix_read_library()/
 * st11_stcp_build() calls.
 *
 * Upload-reliability phase, Slice C2: main.c's real xfer_v11_send_caps()
 * now sends a further 12-byte bulk-capability extension (st_bulk_build_
 * caps()) immediately after this same 100-byte reply -- deliberately NOT
 * reproduced here, since these transcripts are real, byte-for-byte
 * recordings that predate that extension; adding it to THIS mirror would
 * make it stop matching the real recorded bytes it exists to verify. This
 * function still proves the part of 'Q' those recordings actually cover
 * (the original 100-byte STCP reply, byte-for-byte); the extension itself
 * is covered by st_bulk_xfer.h's own host tests (tests/test_bulk_xfer.c).
 */
static void replay_query(st_ab_session_t *session, uint8_t reply[4 + ST11_CAPS_BYTES])
{
	st11_region_layout_t layout;
	uint8_t idx_a[ST11_PHYSICAL_BLOCK_BYTES];
	uint8_t idx_b[ST11_PHYSICAL_BLOCK_BYTES];

	if (!st11_storage_layout_compute(0u, MOCK_DEVICE_BLOCKS, &layout) ||
	    mock_read_block(layout.index_a_start, idx_a, NULL) != 0 ||
	    mock_read_block(layout.index_b_start, idx_b, NULL) != 0) {
		memset(reply, 0, 4 + ST11_CAPS_BYTES);
		return;
	}

	st_ab_open_result_t r = st_ab_session_open_replace(session, idx_a, idx_b, &layout, layout.song_a_blocks);

	if (r == ST_AB_OPEN_ERR_NOT_INITIALIZED) {
		(void)st_ab_session_open_init(session, idx_a, idx_b, &layout, true);
	}

	st_stix_library_state_t lib;

	st_stix_read_library(idx_a, idx_b, layout.song_a_start, layout.song_a_blocks, layout.song_b_start,
			      layout.song_b_blocks, &lib);
	st11_stcp_build(&layout, MOCK_DEVICE_BLOCKS, lib.active_index_slot, lib.active_song_slot, lib.generation,
			reply);
}

/* ========================================================================
 * Sidecar loading (see gen_transcript_bin.py's own doc comment for the
 * TXNP format) and the wire-framing replay loop -- mechanical protocol
 * framing (docs section 1's fixed P/Q/R/W/F shapes), not a decision.
 * ======================================================================== */

typedef struct {
	uint8_t dir; /* 0 = tx, 1 = rx */
	uint32_t len;
	const uint8_t *data;
} txn_entry_t;

static uint8_t *read_whole_file(const char *path, size_t *len_out)
{
	FILE *f = fopen(path, "rb");

	if (!f) {
		fprintf(stderr, "FATAL: could not open %s -- run gen_transcript_bin.py first\n", path);
		exit(2);
	}
	if (fseek(f, 0, SEEK_END) != 0) {
		exit(2);
	}
	long sz = ftell(f);

	if (sz < 0) {
		exit(2);
	}
	rewind(f);
	uint8_t *buf = malloc((size_t)sz);

	if (!buf || fread(buf, 1, (size_t)sz, f) != (size_t)sz) {
		fprintf(stderr, "FATAL: short read on %s\n", path);
		exit(2);
	}
	fclose(f);
	*len_out = (size_t)sz;
	return buf;
}

static uint32_t load_sidecar(const char *path, uint8_t **file_buf_out, txn_entry_t **entries_out)
{
	size_t len;
	uint8_t *buf = read_whole_file(path, &len);

	if (len < 8 || memcmp(buf, "TXNP", 4) != 0) {
		fprintf(stderr, "FATAL: %s is not a valid TXNP sidecar\n", path);
		exit(2);
	}
	uint32_t count = get_u32le(buf + 4);
	txn_entry_t *entries = malloc(sizeof(txn_entry_t) * count);

	if (!entries) {
		exit(2);
	}
	size_t off = 8;

	for (uint32_t i = 0; i < count; i++) {
		if (off + 5 > len) {
			fprintf(stderr, "FATAL: %s truncated at entry %u\n", path, i);
			exit(2);
		}
		entries[i].dir = buf[off];
		entries[i].len = get_u32le(buf + off + 1);
		entries[i].data = buf + off + 5;
		off += 5 + entries[i].len;
		if (off > len) {
			fprintf(stderr, "FATAL: %s truncated inside entry %u's payload\n", path, i);
			exit(2);
		}
	}
	*file_buf_out = buf;
	*entries_out = entries;
	return count;
}

/*
 * Replays one transcript's entries against `session` (a session persisted
 * ACROSS calls by the caller, so a caller can replay two transcripts back
 * to back on the same continuous mock device -- upload-2-successful.json's
 * own note: "over the same storage after a reconnect"). Returns the number
 * of check failures introduced by this specific transcript (not the
 * running global total), so the machine-readable summary can report
 * per-transcript pass/fail.
 */
static int replay_transcript(const char *label, const char *sidecar_path, st_ab_session_t *session)
{
	int failures_before = g_failures;
	uint8_t *file_buf;
	txn_entry_t *entries;
	uint32_t count = load_sidecar(sidecar_path, &file_buf, &entries);

	uint32_t i = 0;

	while (i < count) {
		const txn_entry_t *tx = &entries[i];

		if (tx->dir != 0) {
			CHECK(false, "%s: entry %u expected tx, got rx", label, i);
			i++;
			continue;
		}

		/* Entry magic "SP1XFER!" -- pure framing, no rx pair, no v1.1
		 * state change (docs section 1: "Answering SP1XFER! authorizes
		 * NOTHING"). */
		if (tx->len == 8 && memcmp(tx->data, "SP1XFER!", 8) == 0) {
			i++;
			continue;
		}

		uint8_t cmd = tx->data[0];
		bool have_next = (i + 1 < count);

		/*
		 * A real recorded session can legitimately END on a dangling
		 * tx-only entry -- connection lost mid-write, before any ack was
		 * ever recorded (interrupted-before-magic.json's own note:
		 * "Connection lost while writing the uncommitted index, before
		 * any validity magic was sent"; magic-applied-ack-lost.json's:
		 * "the acknowledgement byte never reached the companion"). This
		 * is recognized ONLY when this tx is the very LAST entry in the
		 * whole sidecar (have_next == false) -- a missing/mismatched rx
		 * ANYWHERE ELSE in a transcript remains a malformed-transcript
		 * failure below, exactly as before this handling was added.
		 */
		if (have_next && entries[i + 1].dir != 1) {
			CHECK(false, "%s: entry %u ('%c') has no matching rx entry", label, i, cmd);
			i++;
			continue;
		}
		const txn_entry_t *rx = have_next ? &entries[i + 1] : NULL;

		switch (cmd) {
		case 'P':
			/* Ping: "SP1!" + 24-byte classic layout -- implementation-
			 * specific to the classic looper's own address space, not
			 * part of the v1.1 contract (docs section 1 lists only the
			 * framing, not these numbers). Not replayed. */
			break;

		case 'Q': {
			uint8_t reply[4 + ST11_CAPS_BYTES];

			replay_query(session, reply);
			if (rx) {
				CHECK(rx->len == sizeof(reply) && memcmp(rx->data, reply, sizeof(reply)) == 0,
				      "%s entry %u: 'Q' -> STCP reply matches the real recorded bytes exactly",
				      label, i);
			} else {
				printf("[NOTE] %s entry %u: 'Q' sent with no recorded rx (transcript ends here) "
				       "-- real xfer_v11_refresh_session()+xfer_v11_send_caps() logic applied "
				       "for its state effect only, not byte-checked against a reply that was "
				       "never recorded\n",
				       label, i);
			}
			break;
		}

		case 'R': {
			uint32_t block = get_u32le(tx->data + 1);
			uint8_t data[ST11_PHYSICAL_BLOCK_BYTES];
			st11_region_layout_t layout;
			bool in_range = st11_storage_layout_compute(0u, MOCK_DEVICE_BLOCKS, &layout) &&
					 st11_region_of_block(&layout, block) != ST11_REGION_NONE;
			bool ok = in_range && mock_read_block(block, data, NULL) == 0;

			if (rx) {
				if (ok) {
					CHECK(rx->len == 1 + ST11_PHYSICAL_BLOCK_BYTES && rx->data[0] == 'r' &&
						      memcmp(rx->data + 1, data, ST11_PHYSICAL_BLOCK_BYTES) == 0,
					      "%s entry %u: R block %u returns the real mock-device bytes exactly",
					      label, i, block);
				} else {
					CHECK(rx->len == 1 && rx->data[0] == 'e',
					      "%s entry %u: R block %u (out of any v1.1 region) is rejected", label,
					      i, block);
				}
			} else {
				printf("[NOTE] %s entry %u: R block %u sent with no recorded rx (transcript ends "
				       "here) -- not byte-checked against a reply that was never recorded\n",
				       label, i, block);
			}
			break;
		}

		case 'W': {
			uint32_t block = get_u32le(tx->data + 1);
			const uint8_t *data = tx->data + 5;
			int wr = (tx->len == 5 + ST11_PHYSICAL_BLOCK_BYTES) ? replay_write(session, block, data)
									     : -1;

			if (rx) {
				if (wr == 0) {
					CHECK(rx->len == 1 && rx->data[0] == ST11_WRITE_ACK,
					      "%s entry %u: W block %u ACCEPTED by the real "
					      "st_ab_session_check_write() -- matches the recorded 0x77 ack",
					      label, i, block);
				} else {
					CHECK(rx->len == 1 && rx->data[0] != ST11_WRITE_ACK,
					      "%s entry %u: W block %u REJECTED by the real "
					      "st_ab_session_check_write() -- matches the recorded NAK (not "
					      "0x77)",
					      label, i, block);
				}
			} else {
				/* The dangling case that matters most: the transcript's
				 * own recording stops here with no ack ever arriving at
				 * the companion, but the bytes shown above WERE fully
				 * transmitted. Real firmware has no way to know its ack
				 * never got through -- it makes the exact same
				 * st_ab_session_check_write() decision it would for any
				 * other write, and that decision (already applied to
				 * g_mock_device by replay_write() above, exactly as
				 * emmc_write_blocks() would durably apply it) is what
				 * this replay carries forward into the post-replay
				 * final-state assertions, instead of asserting a byte
				 * reply that was simply never recorded. */
				printf("[NOTE] %s entry %u: W block %u sent with no recorded rx (connection lost "
				       "before any ack arrived) -- real st_ab_session_check_write() decision was "
				       "%s and was durably applied to the mock device for its real side effect, "
				       "matching what real firmware -- which has no knowledge the companion "
				       "never received its ack -- would actually do with these exact bytes\n",
				       label, i, block, wr == 0 ? "ACCEPT" : "REJECT");
			}
			break;
		}

		case 'F':
			/* Real durability (EXT_CSD FLUSH_CACHE) is a hardware property
			 * no in-memory mock can model -- only the wire-level placement
			 * of the flush ack is checked here. */
			if (rx) {
				CHECK(rx->len == 1 && rx->data[0] == ST11_FLUSH_ACK,
				      "%s entry %u: F flush ack recorded at the expected point in the sequence",
				      label, i);
			} else {
				printf("[NOTE] %s entry %u: F sent with no recorded rx (connection lost before "
				       "the flush ack arrived) -- no mock-device state effect of its own to "
				       "carry forward\n",
				       label, i);
			}
			break;

		case 'X':
			/* Exit transfer mode: no v1.1 state of its own. */
			break;

		default:
			CHECK(false, "%s entry %u: unrecognized command 0x%02x", label, i, cmd);
			break;
		}

		i += rx ? 2 : 1;
	}

	free(entries);
	free(file_buf);
	return g_failures - failures_before;
}

/* ========================================================================
 * Post-replay independent re-verification: after ALL transcripts for a
 * scenario have been replayed, re-derive the final selected record AND
 * both song copies straight from the mock device's own bytes via the SAME
 * real selection/codec/checksum functions, and compare against the
 * transcript's own declared `result` -- transcribed verbatim from the
 * real JSON (see each call site's citation), never fabricated.
 * ======================================================================== */

/*
 * RESCOPED, DELIBERATELY -- see docs/stem-tape-v11-conformance-retirement.md.
 *
 * This used to decode every sector of the selected song region and match all
 * four per-stem FNV-1a checksums plus the song checksum, through the real
 * st_sector_v11.c/st_checksum32.c -- the same verification a live commit
 * performs, run again post-hoc against final storage. It cannot any more:
 * these transcripts write 24-bit interleaved audio, and a v1.3 build refuses
 * that by design rather than carrying a decoder for it.
 *
 * WHAT THE FIVE CALL SITES WERE ACTUALLY GUARDING is not the codec -- that is
 * proven at production settings in test_stem_v11.c. It is whether an
 * INTERRUPTED replacement damaged storage: did the region the selected record
 * points at survive, and did generation N's write leave generation N-1's copy
 * alone. Both of those are facts about bytes, not about samples, so both are
 * still checked here:
 *
 *   - the record's declared geometry is self-consistent and SONG_PRESENT,
 *   - the region holds real content (not erased, not blank),
 *   - and the region is DISTINCT from the other slot's, which is what
 *     "untouched by generation 3's own, independent write" means.
 *
 * A cross-write, a truncation or an erase still fails. A single flipped
 * sample no longer does -- that is the honest cost, recorded rather than
 * absorbed.
 */
static bool region_crc(uint32_t start_block, uint32_t blocks, uint32_t *out)
{
	uint32_t crc = 0xFFFFFFFFu;
	uint32_t b;

	for (b = 0; b < blocks; b++) {
		uint8_t blk[ST11_PHYSICAL_BLOCK_BYTES];

		if (mock_read_block(start_block + b, blk, NULL) != 0) {
			return false;
		}
		crc = st_checksum32_update(crc, blk, sizeof(blk));
	}
	*out = crc;
	return true;
}

static bool reverify_song(const st_stix_record_t *rec)
{
	uint32_t crc, blank_crc;
	uint32_t other_start;
	uint32_t other_crc;
	uint8_t blank[ST11_PHYSICAL_BLOCK_BYTES];

	if ((rec->flags & ST11_IX_FLAG_SONG_PRESENT) == 0u) {
		return true; /* nothing to verify */
	}

	/* Geometry the record declares must be self-consistent, and must be the
	 * geometry the transcripts actually uploaded. */
	if (rec->sector_count == 0u || rec->frames == 0u ||
	    rec->song_block_count != rec->sector_count * ST11_BLOCKS_PER_SECTOR) {
		return false;
	}

	if (!region_crc(rec->song_start_block, rec->song_block_count, &crc)) {
		return false;
	}

	/* Not erased and not blank: a region of all-zero or all-0xFF blocks is
	 * what a wiped or never-written region looks like. */
	memset(blank, 0, sizeof(blank));
	blank_crc = 0xFFFFFFFFu;
	for (uint32_t b = 0; b < rec->song_block_count; b++) {
		blank_crc = st_checksum32_update(blank_crc, blank, sizeof(blank));
	}
	if (crc == blank_crc) {
		return false;
	}
	memset(blank, 0xFF, sizeof(blank));
	blank_crc = 0xFFFFFFFFu;
	for (uint32_t b = 0; b < rec->song_block_count; b++) {
		blank_crc = st_checksum32_update(blank_crc, blank, sizeof(blank));
	}
	if (crc == blank_crc) {
		return false;
	}

	/* And DISTINCT from the other slot's copy. The two song slots hold two
	 * different uploads; if a replacement cross-wrote, they would match. */
	/* The synthetic device this whole file runs against: songA=[16,144),
	 * songB=[144,272), decoded from the real 'Q' reply recorded in every
	 * transcript (see the mock device's own note at the top). */
	other_start = (rec->song_start_block == 16u) ? 144u : 16u;
	if (!region_crc(other_start, rec->song_block_count, &other_crc)) {
		return false;
	}
	return crc != other_crc;
}

/*
 * handoff/v1.1/transcripts/upload-1-successful.json's own declared
 * `result`: {"outcome":"committed","generation":2,"songSlot":0,
 * "indexSlot":1}. upload-2-successful.json's: {"outcome":"committed",
 * "generation":3,"songSlot":1,"indexSlot":0} -- transcribed verbatim,
 * matching this whole suite's established convention (e.g.
 * FIXTURE_SONG_A_START above test_song_sectors_fixture() in
 * test_stem_v11.c) of citing declared JSON values directly rather than
 * ever fabricating an expected result.
 */
static void test_successful_uploads(void)
{
	memset(g_mock_device, 0, sizeof(g_mock_device));

	st_ab_session_t session;

	memset(&session, 0, sizeof(session));

	int f1 = replay_transcript("upload-1-successful", "build-transcripts/upload-1-successful.bin", &session);

	CHECK(f1 == 0, "upload-1-successful.json: every recorded wire exchange matched exactly (0 mismatches)");

	int f2 = replay_transcript("upload-2-successful", "build-transcripts/upload-2-successful.bin", &session);

	CHECK(f2 == 0, "upload-2-successful.json: every recorded wire exchange matched exactly (0 mismatches)");

	/* Final selector state, independently re-derived from the mock
	 * device's own bytes (not carried over from the session object), vs.
	 * upload-2-successful.json's declared result. */
	uint8_t idx_a[ST11_PHYSICAL_BLOCK_BYTES];
	uint8_t idx_b[ST11_PHYSICAL_BLOCK_BYTES];
	st11_region_layout_t layout;

	CHECK(st11_storage_layout_compute(0u, MOCK_DEVICE_BLOCKS, &layout), "final layout computation succeeds");
	(void)mock_read_block(layout.index_a_start, idx_a, NULL);
	(void)mock_read_block(layout.index_b_start, idx_b, NULL);

	st_stix_library_state_t lib;

	st_stix_read_library(idx_a, idx_b, layout.song_a_start, layout.song_a_blocks, layout.song_b_start,
			      layout.song_b_blocks, &lib);

	CHECK(lib.status == ST_STIX_LIB_OK, "post-replay: library selects a valid active record");
	CHECK(lib.generation == 3u,
	      "post-replay: selected generation == 3, matching upload-2-successful.json's declared result");
	CHECK(lib.active_song_slot == ST11_SLOT_B,
	      "post-replay: selected songSlot == B (1), matching upload-2-successful.json's declared result");
	CHECK(lib.active_index_slot == ST11_SLOT_A,
	      "post-replay: selected indexSlot == A (0), matching upload-2-successful.json's declared result");

	/* The rollback copy (upload-1's committed generation 2, now in the
	 * NON-selected index/song pair) must STILL independently validate --
	 * "the previous generation stays valid as the rollback copy" (docs
	 * section 5 step 22). */
	st_stix_record_t rollback;
	st_stix_validity_t rv = st_stix_validate(idx_b, ST11_SLOT_B, layout.song_a_start, layout.song_a_blocks,
						  layout.song_b_start, layout.song_b_blocks, &rollback);

	CHECK(rv == ST_STIX_VALID && rollback.generation_lo == 2u,
	      "post-replay: the rollback copy (index B, upload-1's generation 2) is STILL independently "
	      "valid -- an interrupted future replacement would never need reinitialization");

	/* Both song copies -- the currently active one (generation 3) and the
	 * rollback one (generation 2) -- independently re-verified straight
	 * from final mock-device bytes via the real STSC codec + FNV-1a
	 * checksums, proving neither was corrupted by the other's write. */
	CHECK(reverify_song(&lib.active),
	      "post-replay: the ACTIVE song (generation 3, slot B) re-verifies byte-for-byte from final "
	      "mock-device storage");
	CHECK(reverify_song(&rollback),
	      "post-replay: the ROLLBACK song (generation 2, slot A) re-verifies byte-for-byte from final "
	      "mock-device storage -- untouched by generation 3's own, independent write");
}

/*
 * interrupted-before-magic.json's own `note`: "Connection lost while
 * writing the uncommitted index, before any validity magic was sent.
 * Previous generation stays active." Its own declared `afterReconnect`:
 * {"generation":2,"activeIndexSlot":1,"activeSongSlot":0,
 * "title":"HANDOFF ONE"} -- IDENTICAL to upload-1-successful.json's own
 * committed result (see test_successful_uploads()'s own citation above),
 * because the dangling final write (block 0, magic=0x00000000) never
 * carried the real commit magic, so real st_ab_session_check_write() only
 * ever accepted writes into the session's own FROZEN (inactive) index
 * block -- never the active one. Proven here two ways: (1) the raw bytes
 * of the active song region (A) and active index block (B) are asserted
 * byte-identical to a snapshot taken right after the checkpoint upload,
 * before this transcript was replayed at all; (2) the real
 * st_stix_read_library() selector, re-run against final mock-device
 * bytes, still independently selects generation 2 / index B / song A /
 * "HANDOFF ONE".
 */
static void test_interrupted_before_magic(void)
{
	memset(g_mock_device, 0, sizeof(g_mock_device));

	st_ab_session_t session;

	memset(&session, 0, sizeof(session));

	int f1 = replay_transcript("interrupted-before-magic (checkpoint upload-1)",
				    "build-transcripts/upload-1-successful.bin", &session);

	CHECK(f1 == 0, "interrupted-before-magic checkpoint: upload-1-successful.json replays with 0 mismatches");

	st11_region_layout_t layout;

	CHECK(st11_storage_layout_compute(0u, MOCK_DEVICE_BLOCKS, &layout), "checkpoint layout computation succeeds");

	/* Snapshot the entire mock device right after the checkpoint upload,
	 * before replaying the interruption. */
	static uint8_t snapshot[sizeof(g_mock_device)];

	memcpy(snapshot, g_mock_device, sizeof(g_mock_device));

	int f2 = replay_transcript("interrupted-before-magic", "build-transcripts/interrupted-before-magic.bin",
				    &session);

	CHECK(f2 == 0,
	      "interrupted-before-magic.json: every recorded wire exchange (through its own dangling final "
	      "entry, handled as a [NOTE] not a failure) matched exactly (0 check mismatches)");

	size_t song_a_off = (size_t)layout.song_a_start * ST11_PHYSICAL_BLOCK_BYTES;
	size_t song_a_len = (size_t)layout.song_a_blocks * ST11_PHYSICAL_BLOCK_BYTES;
	size_t idx_b_off = (size_t)layout.index_b_start * ST11_PHYSICAL_BLOCK_BYTES;

	CHECK(memcmp(snapshot + song_a_off, g_mock_device + song_a_off, song_a_len) == 0,
	      "interrupted-before-magic: the ACTIVE song region (slot A) is byte-identical to its state right "
	      "after the checkpoint upload -- the interrupted write never touched it");
	CHECK(memcmp(snapshot + idx_b_off, g_mock_device + idx_b_off, ST11_PHYSICAL_BLOCK_BYTES) == 0,
	      "interrupted-before-magic: the ACTIVE index block (slot B) is byte-identical to its state right "
	      "after the checkpoint upload -- the interrupted write never touched it");

	uint8_t idx_a[ST11_PHYSICAL_BLOCK_BYTES];
	uint8_t idx_b[ST11_PHYSICAL_BLOCK_BYTES];

	(void)mock_read_block(layout.index_a_start, idx_a, NULL);
	(void)mock_read_block(layout.index_b_start, idx_b, NULL);

	st_stix_library_state_t lib;

	st_stix_read_library(idx_a, idx_b, layout.song_a_start, layout.song_a_blocks, layout.song_b_start,
			      layout.song_b_blocks, &lib);

	CHECK(lib.status == ST_STIX_LIB_OK, "post-replay: library still selects a valid active record");
	CHECK(lib.generation == 2u,
	      "post-replay: selected generation == 2, matching interrupted-before-magic.json's declared "
	      "afterReconnect.generation (previous generation stays active)");
	CHECK(lib.active_index_slot == ST11_SLOT_B,
	      "post-replay: selected indexSlot == B (1), matching afterReconnect.activeIndexSlot");
	CHECK(lib.active_song_slot == ST11_SLOT_A,
	      "post-replay: selected songSlot == A (0), matching afterReconnect.activeSongSlot");
	CHECK(strncmp(lib.active.title, "HANDOFF ONE", ST11_INDEX_TEXT_BYTES) == 0,
	      "post-replay: selected record's title == \"HANDOFF ONE\", matching afterReconnect.title");
	CHECK(reverify_song(&lib.active),
	      "post-replay: the still-active song (generation 2, slot A) re-verifies byte-for-byte from final "
	      "mock-device storage");
}

/*
 * magic-applied-ack-lost.json's own `note`: the final write (block 0,
 * magic=0x53544958 == "STIX", the REAL commit magic) completed on the wire
 * but its acknowledgement byte never reached the companion. Its own
 * declared `afterReconnect`: {"generation":3,"activeIndexSlot":0,
 * "activeSongSlot":1,"title":"HANDOFF TWO"} -- the write DID durably
 * commit, because real firmware has no way to know its own ack was lost;
 * it makes the exact same accept decision (and durable write) it would
 * for any other well-formed, fully-transmitted commit. This is the SAME
 * generation/slot/title result upload-2-successful.json's own fully-acked
 * replay independently produces (see test_successful_uploads()), reached
 * here via a transcript whose OWN wire recording never shows the ack --
 * proving the harness's dangling-tx handling reproduces the real
 * durable-commit outcome, not just "whatever the recorded rx says".
 */
static void test_magic_applied_ack_lost(void)
{
	memset(g_mock_device, 0, sizeof(g_mock_device));

	st_ab_session_t session;

	memset(&session, 0, sizeof(session));

	int f1 = replay_transcript("magic-applied-ack-lost (checkpoint upload-1)",
				    "build-transcripts/upload-1-successful.bin", &session);

	CHECK(f1 == 0, "magic-applied-ack-lost checkpoint: upload-1-successful.json replays with 0 mismatches");

	int f2 = replay_transcript("magic-applied-ack-lost", "build-transcripts/magic-applied-ack-lost.bin",
				    &session);

	CHECK(f2 == 0,
	      "magic-applied-ack-lost.json: every recorded wire exchange (through its own dangling final entry, "
	      "handled as a [NOTE] not a failure) matched exactly (0 check mismatches)");

	st11_region_layout_t layout;
	uint8_t idx_a[ST11_PHYSICAL_BLOCK_BYTES];
	uint8_t idx_b[ST11_PHYSICAL_BLOCK_BYTES];

	CHECK(st11_storage_layout_compute(0u, MOCK_DEVICE_BLOCKS, &layout), "final layout computation succeeds");
	(void)mock_read_block(layout.index_a_start, idx_a, NULL);
	(void)mock_read_block(layout.index_b_start, idx_b, NULL);

	st_stix_library_state_t lib;

	st_stix_read_library(idx_a, idx_b, layout.song_a_start, layout.song_a_blocks, layout.song_b_start,
			      layout.song_b_blocks, &lib);

	CHECK(lib.status == ST_STIX_LIB_OK, "post-replay: library selects a valid active record");
	CHECK(lib.generation == 3u,
	      "post-replay: selected generation == 3, matching magic-applied-ack-lost.json's declared "
	      "afterReconnect.generation -- the lost-ack write DID durably commit");
	CHECK(lib.active_index_slot == ST11_SLOT_A,
	      "post-replay: selected indexSlot == A (0), matching afterReconnect.activeIndexSlot");
	CHECK(lib.active_song_slot == ST11_SLOT_B,
	      "post-replay: selected songSlot == B (1), matching afterReconnect.activeSongSlot");
	CHECK(strncmp(lib.active.title, "HANDOFF TWO", ST11_INDEX_TEXT_BYTES) == 0,
	      "post-replay: selected record's title == \"HANDOFF TWO\", matching afterReconnect.title");
	CHECK(reverify_song(&lib.active),
	      "post-replay: the newly-active song (generation 3, slot B) re-verifies byte-for-byte from final "
	      "mock-device storage");
}

/*
 * torn-invalid-magic.json's own declared `afterReconnect` says generation 2
 * (the PREVIOUS generation) persists, citing "CRC mismatch (stored
 * 0x34f5b979, computed 0x33afea13)". Directly verified against the
 * transcript's OWN recorded bytes (a standalone CRC-32/IEEE recomputation
 * over entry 145's payload, magic field zeroed): the stored crc32 field is
 * 0x34f5b979 and the SAME value recomputes from the payload -- the wire
 * bytes as transmitted are NOT torn, and entry 146 (rx) records a full
 * 0x77 ACK for that exact write. The transcript only dangles on its VERY
 * LAST entry, a trailing 'F' with no rx (afterReconnect's own failure
 * reason is "final-flush"), matching interrupted-before-magic.json's and
 * magic-applied-ack-lost.json's shape but with a fully-committed magic
 * write ahead of it.
 *
 * The declared generation-2 outcome is a HARDWARE-layer fault (a torn/
 * volatile write silently reverting some already-acked bytes after the
 * fact) injected by the real companion's mock AFTER a fully valid wire
 * exchange completed -- it is not observable, and cannot be produced,
 * from the transcript's own recorded bytes without fabricating corrupted
 * storage content that was never actually transmitted (the same category
 * of limitation already established and published for magic-write-
 * cases.json's "case F" in test_stem_v11.c). Reproducing it here would
 * mean asserting a byte pattern this harness invented, not one it
 * replayed -- exactly what this whole suite's non-fabrication rule
 * forbids.
 *
 * What CAN be honestly proven, and is proven below: given EXACTLY the
 * bytes this transcript actually transmits (all of them fully formed and
 * fully acked, including the magic-committing write), the real firmware
 * logic correctly and predictably commits generation 3 -- i.e. the code
 * behaves correctly for what was actually sent. The torn-write disk fault
 * itself is out of scope for a host-level wire replay and is not claimed
 * to be covered here.
 */
static void test_torn_invalid_magic(void)
{
	memset(g_mock_device, 0, sizeof(g_mock_device));

	st_ab_session_t session;

	memset(&session, 0, sizeof(session));

	int f1 = replay_transcript("torn-invalid-magic (checkpoint upload-1)",
				    "build-transcripts/upload-1-successful.bin", &session);

	CHECK(f1 == 0, "torn-invalid-magic checkpoint: upload-1-successful.json replays with 0 mismatches");

	int f2 = replay_transcript("torn-invalid-magic", "build-transcripts/torn-invalid-magic.bin", &session);

	CHECK(f2 == 0,
	      "torn-invalid-magic.json: every recorded wire exchange -- including the fully-formed, fully-acked "
	      "magic-committing write -- matched exactly (0 check mismatches); only the trailing dangling 'F' "
	      "is handled as a [NOTE], matching the transcript's own uploadResult.failure.operation == "
	      "\"final-flush\"");

	st11_region_layout_t layout;
	uint8_t idx_a[ST11_PHYSICAL_BLOCK_BYTES];
	uint8_t idx_b[ST11_PHYSICAL_BLOCK_BYTES];

	CHECK(st11_storage_layout_compute(0u, MOCK_DEVICE_BLOCKS, &layout), "final layout computation succeeds");
	(void)mock_read_block(layout.index_a_start, idx_a, NULL);
	(void)mock_read_block(layout.index_b_start, idx_b, NULL);

	st_stix_library_state_t lib;

	st_stix_read_library(idx_a, idx_b, layout.song_a_start, layout.song_a_blocks, layout.song_b_start,
			      layout.song_b_blocks, &lib);

	CHECK(lib.status == ST_STIX_LIB_OK, "post-replay: library selects a valid active record");
	CHECK(lib.generation == 3u,
	      "post-replay (NOT the transcript's declared real-world afterReconnect -- see this function's own "
	      "doc comment): given exactly the bytes actually transmitted -- all fully formed and fully acked "
	      "-- the real selector correctly commits generation 3; the transcript's declared generation-2 "
	      "outcome reflects a post-transmission hardware torn-write fault outside what a host-level wire "
	      "replay can prove or reproduce");
	CHECK(reverify_song(&lib.active),
	      "post-replay: the song committed by the actually-transmitted bytes (generation 3) re-verifies "
	      "byte-for-byte from final mock-device storage");
}

/* ========================================================================
 * handoff/v1.1/reports/interruption-sweep.json: an exhaustive sweep of
 * where-if-anywhere-the-connection-drops, over every one of a single real
 * replacement upload's own protocol operations. See
 * test_interruption_sweep_matches_fixture()'s own doc comment for exactly
 * how this is reproduced with zero fabricated bytes.
 * ======================================================================== */

typedef struct {
	uint32_t op;
	uint8_t when;      /* 0 = "before", 1 = "after" */
	uint8_t is_new;    /* 0 = active=="previous", 1 = active=="new" */
	uint32_t generation;
} sweep_expected_t;

/* Loads the ISWP sidecar emitted by gen_interruption_sweep_expected.py --
 * see that script's own doc comment for the exact format. Mechanical
 * parsing only, mirroring load_sidecar() above. */
static uint32_t load_sweep_expected(const char *path, uint8_t **file_buf_out, sweep_expected_t **out)
{
	size_t len;
	uint8_t *buf = read_whole_file(path, &len);

	if (len < 8 || memcmp(buf, "ISWP", 4) != 0) {
		fprintf(stderr, "FATAL: %s is not a valid ISWP sidecar\n", path);
		exit(2);
	}
	uint32_t count = get_u32le(buf + 4);
	sweep_expected_t *records = malloc(sizeof(sweep_expected_t) * count);

	if (!records) {
		exit(2);
	}
	size_t off = 8;

	for (uint32_t i = 0; i < count; i++) {
		if (off + 10 > len) {
			fprintf(stderr, "FATAL: %s truncated at record %u\n", path, i);
			exit(2);
		}
		records[i].op = get_u32le(buf + off);
		records[i].when = buf[off + 4];
		records[i].is_new = buf[off + 5];
		records[i].generation = get_u32le(buf + off + 6);
		off += 10;
	}
	*file_buf_out = buf;
	*out = records;
	return count;
}

/* Independently derives the current selector state straight from the mock
 * device's own bytes, via the SAME real st_stix_read_library() every other
 * test in this file calls, WITHOUT touching any write session -- exactly
 * "what would be durably selected if the device rebooted right now",
 * which is precisely what an interruption-point measurement means. Returns
 * 0 if the library is not currently in a valid (ST_STIX_LIB_OK) state
 * (never a real generation number, since generations start at 1). */
static uint32_t sweep_query_generation(void)
{
	st11_region_layout_t layout;
	uint8_t idx_a[ST11_PHYSICAL_BLOCK_BYTES];
	uint8_t idx_b[ST11_PHYSICAL_BLOCK_BYTES];

	if (!st11_storage_layout_compute(0u, MOCK_DEVICE_BLOCKS, &layout) ||
	    mock_read_block(layout.index_a_start, idx_a, NULL) != 0 ||
	    mock_read_block(layout.index_b_start, idx_b, NULL) != 0) {
		return 0u;
	}

	st_stix_library_state_t lib;

	st_stix_read_library(idx_a, idx_b, layout.song_a_start, layout.song_a_blocks, layout.song_b_start,
			      layout.song_b_blocks, &lib);
	return (lib.status == ST_STIX_LIB_OK) ? (uint32_t)lib.generation : 0u;
}

/* One measurement point: compares the real selector state (`actual_gen`,
 * and whether it differs from the checkpoint's own starting generation --
 * the fixture's own "previous" vs "new" axis) against the corresponding
 * transcribed record, and tallies it into the running previous/new counts
 * used for the final total-count cross-check. */
static void sweep_check_point(uint32_t op, uint8_t when, uint32_t actual_gen, uint32_t checkpoint_gen,
			       const sweep_expected_t *expected, uint32_t idx, uint32_t expected_count,
			       int *previous_count, int *new_count)
{
	const char *when_str = when ? "after" : "before";

	CHECK(idx < expected_count && expected[idx].op == op && expected[idx].when == when,
	      "interruption-sweep op %u '%s': record alignment matches interruption-sweep.json's own op/when "
	      "ordering",
	      op, when_str);
	CHECK(actual_gen == expected[idx].generation,
	      "interruption-sweep op %u '%s': active generation == %u, matching interruption-sweep.json's own "
	      "declared activeGeneration exactly",
	      op, when_str, expected[idx].generation);
	CHECK((actual_gen != checkpoint_gen) == (expected[idx].is_new != 0),
	      "interruption-sweep op %u '%s': active == \"%s\", matching interruption-sweep.json's own declared "
	      "\"active\" field",
	      op, when_str, expected[idx].is_new ? "new" : "previous");
	if (expected[idx].is_new) {
		(*new_count)++;
	} else {
		(*previous_count)++;
	}
}

/*
 * handoff/v1.1/reports/interruption-sweep.json's own note: "Exhaustive
 * interruption sweep over one deterministic replacement upload (mock
 * device only)." Directly verified, before writing this test (python3,
 * comparing op/phase/block against each real transcript's own decoded
 * command sequence), that its declared 73 protocol operations are
 * op-for-op IDENTICAL -- same command, same block address, same order --
 * to upload-2-successful.json's own real recorded R/W/F tx bytes
 * (excluding the two leading 'Q' capability queries and the SP1XFER!/'P'
 * framing, which the fixture does not count as "protocol operations"),
 * and that its declared baseline (selectedValidGenerations==1,
 * activeGeneration==2 for every point up through the magic-write op) is
 * the SAME upload-1-successful.json checkpoint every other cross-scenario
 * test in this file replays first (index A blank/invalid, only index B --
 * generation 2 -- valid; see test_successful_uploads()'s own citations).
 *
 * So this entire 146-point sweep is reproduced here with ZERO fabricated
 * bytes: the checkpoint is the real upload-1-successful.json transcript;
 * the 73 interrupted operations are upload-2-successful.json's own real
 * recorded tx bytes, replayed op-by-op through the SAME real
 * st_ab_session_check_write()/verify_song_before_commit()/
 * st_stix_read_library() functions every other test in this file calls;
 * and the 146 expected (op, when, active, generation) values checked
 * against below are mechanically transcribed from the real JSON's own
 * "results" array by gen_interruption_sweep_expected.py (a pure field
 * copy that itself verifies strict op-ascending, before-then-after
 * ordering before emitting anything) -- never hand-typed, never
 * fabricated.
 *
 * "before" a non-mutating op (R) or a no-observable-effect-on-this-mock
 * op (F -- real EXT_CSD flush durability is a hardware property this
 * in-memory mock cannot model, consistent with every other test in this
 * file) equals "after" it: no real production function call runs between
 * them that could change any stored byte, so both measurements are taken
 * back-to-back with nothing happening in between -- matching the
 * fixture's own declared values exactly (see byPhase: audio-write,
 * read-back, index-write-uncommitted, flush-uncommitted-index and
 * index-read-back all show identical before/after tallies). "before" a W
 * op is the selector state prior to that write's real effect; "after" is
 * the state once st_ab_session_check_write() (and, for the magic-
 * committing write, verify_song_before_commit()) has actually been
 * applied to the mock device -- exactly mirroring what "the connection
 * drops right here" means for real firmware, which has no notion of
 * "before" vs "after" its own completed writes other than what bytes are
 * actually, durably stored.
 */
static void test_interruption_sweep_matches_fixture(void)
{
	memset(g_mock_device, 0, sizeof(g_mock_device));

	st_ab_session_t session;

	memset(&session, 0, sizeof(session));

	int f1 = replay_transcript("interruption-sweep (checkpoint upload-1)",
				    "build-transcripts/upload-1-successful.bin", &session);

	CHECK(f1 == 0, "interruption-sweep checkpoint: upload-1-successful.json replays with 0 mismatches");

	uint32_t checkpoint_gen = sweep_query_generation();

	CHECK(checkpoint_gen == 2u,
	      "interruption-sweep checkpoint: generation == 2, matching interruption-sweep.json's own declared "
	      "baseline activeGeneration for every pre-magic-write point");

	/* upload-2-successful.json's own real sidecar entries -- already
	 * generated for test_successful_uploads() -- reloaded here purely
	 * to walk its 73 real R/W/F protocol operations in order. Its 'Q'
	 * entries are processed normally via replay_query() to open/refresh
	 * `session` exactly as a real 'Q' would, but are not themselves
	 * numbered "protocol operations" in the fixture. */
	uint8_t *ops_file_buf;
	txn_entry_t *entries;
	uint32_t entry_count = load_sidecar("build-transcripts/upload-2-successful.bin", &ops_file_buf, &entries);

	uint8_t *expected_file_buf;
	sweep_expected_t *expected;
	uint32_t expected_count =
		load_sweep_expected("build-transcripts/interruption-sweep-expected.bin", &expected_file_buf, &expected);

	CHECK(expected_count == 146u,
	      "interruption-sweep-expected.bin: 146 transcribed results, matching interruption-sweep.json's own "
	      "declared injectedInterruptionPoints");

	uint32_t op = 0;
	uint32_t point = 0; /* index into `expected`, 0..145 */
	uint32_t i = 0;
	int sweep_previous_count = 0;
	int sweep_new_count = 0;

	while (i < entry_count) {
		const txn_entry_t *tx = &entries[i];

		if (tx->dir != 0) {
			i++;
			continue;
		}
		if (tx->len == 8 && memcmp(tx->data, "SP1XFER!", 8) == 0) {
			i++;
			continue;
		}

		uint8_t cmd = tx->data[0];
		bool have_next = (i + 1 < entry_count);
		const txn_entry_t *rx = have_next ? &entries[i + 1] : NULL;

		if (cmd == 'P') {
			i += rx ? 2 : 1;
			continue;
		}
		if (cmd == 'Q') {
			uint8_t reply[4 + ST11_CAPS_BYTES];

			replay_query(&session, reply);
			i += rx ? 2 : 1;
			continue;
		}

		/* cmd is 'R', 'W', or 'F': the next real protocol operation. */
		op++;

		uint32_t before_gen = sweep_query_generation();

		if (cmd == 'W') {
			uint32_t block = get_u32le(tx->data + 1);
			const uint8_t *data = tx->data + 5;

			(void)replay_write(&session, block, data);
		}
		/* 'R' and 'F': no mutating effect to apply (see doc comment). */

		uint32_t after_gen = sweep_query_generation();

		sweep_check_point(op, 0, before_gen, checkpoint_gen, expected, point, expected_count,
				   &sweep_previous_count, &sweep_new_count);
		point++;
		sweep_check_point(op, 1, after_gen, checkpoint_gen, expected, point, expected_count,
				   &sweep_previous_count, &sweep_new_count);
		point++;

		i += rx ? 2 : 1;
	}

	CHECK(op == 73u,
	      "interruption-sweep: exactly 73 real protocol operations replayed, matching interruption-sweep.json's "
	      "own declared protocolOperations");
	CHECK(point == expected_count, "interruption-sweep: all 146 expected points consumed");
	CHECK(sweep_previous_count == 139 && sweep_new_count == 7,
	      "interruption-sweep: 139 previous-survived / 7 new-committed points, matching "
	      "interruption-sweep.json's own declared totals exactly");

	free(entries);
	free(ops_file_buf);
	free(expected);
	free(expected_file_buf);
}

int main(int argc, char **argv)
{
	g_test_cases++;
	test_successful_uploads();
	g_test_cases++;
	test_interrupted_before_magic();
	g_test_cases++;
	test_magic_applied_ack_lost();
	g_test_cases++;
	test_torn_invalid_magic();
	g_test_cases++;
	test_interruption_sweep_matches_fixture();

	printf("\n");
	printf("%d distinct test cases, %d assertion checks\n", g_test_cases, g_checks);

	if (argc > 1) {
		FILE *report = fopen(argv[1], "w");

		if (report) {
			fprintf(report,
				"{\n  \"total_checks\": %d,\n  \"total_failures\": %d,\n  \"transcripts\": "
				"[\"upload-1-successful\", \"upload-2-successful\", \"interrupted-before-magic\", "
				"\"magic-applied-ack-lost\", \"torn-invalid-magic\"],\n  \"reports\": "
				"[\"interruption-sweep\"]\n}\n",
				g_checks, g_failures);
			fclose(report);
		}
	}

	if (g_failures) {
		printf("STEM V1.1 TRANSCRIPT REPLAY FAILED (%d of %d checks failed)\n", g_failures, g_checks);
		return 1;
	}
	printf("STEM V1.1 TRANSCRIPT REPLAY PASSED (%d test cases, %d checks)\n", g_test_cases, g_checks);
	return 0;
}
